## .yocto/conf/layer.conf
```bitbake
# We have a conf and classes directory, add to BBPATH
BBPATH .= ":${LAYERDIR}"

# We have recipes-* directories, add to BBFILES
BBFILES += "${LAYERDIR}/recipes-*/*/*.bb \
            ${LAYERDIR}/recipes-*/*/*.bbappend"

BBFILE_COLLECTIONS += "amazon-kvs-webrtc-sdk-c"
BBFILE_PATTERN_amazon-kvs-webrtc-sdk-c = "^${LAYERDIR}/"
BBFILE_PRIORITY_amazon-kvs-webrtc-sdk-c = "6"

LAYERDEPENDS_amazon-kvs-webrtc-sdk-c = "core"
LAYERSERIES_COMPAT_amazon-kvs-webrtc-sdk-c = "scarthgap"
```
